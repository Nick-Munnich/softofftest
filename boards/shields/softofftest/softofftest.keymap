/*
 * Copyright (c) 2020 The ZMK Contributors
 *
 * SPDX-License-Identifier: MIT
 */

#include <behaviors.dtsi>
#include <dt-bindings/zmk/keys.h>

/ {
        keymap {
                compatible = "zmk,keymap";

                default_layer {
                        bindings = <&kp A  &kp B &kp E &kp D>;
                };
        };
};
